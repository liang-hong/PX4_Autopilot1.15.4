## src/drivers/oled_display/Kconfig
```kconfig
menu "oled_display"
    menuconfig COMMON_OLED_DISPLAY
        bool "Common oled display"
        default n
        select DRIVERS_OLED_DISPLAY_SH1106_NOTIFY
        ---help---
            Enable default set of oled display drivers
    rsource "*/Kconfig"
endmenu
```

## src/drivers/oled_display/sh1106_notify/Kconfig
```kconfig
menuconfig DRIVERS_OLED_DISPLAY_SH1106_NOTIFY
	bool "sh1106_notify"
	default n
	---help---
		Enable support for i2c screen
```
